#include <Arduino.h>
#include "my_code.h"

void ProgressBarFPS::drawProgressBar(Adafruit_SSD1306 &display, int x, int y, int progress, bool clearAndDisplay)
{
  int barWidth = 128;
  int barHeight = 16;
  int filledWidth = (barWidth * progress) / 100;

  if (clearAndDisplay)
  {
    display.clearDisplay();
  }

  // Draw the empty progress bar
  display.drawRect(x, y, barWidth, barHeight, SSD1306_WHITE);

  // Draw the filled part
  display.fillRect(x, y, filledWidth, barHeight, SSD1306_WHITE);

  if (clearAndDisplay)
  {
    display.display();
  }
}

unsigned char reverseBits(unsigned char byte)
{
  unsigned char reversedByte = 0;
  for (int i = 0; i < 8; ++i)
  {
    reversedByte <<= 1;         // Shift the reversed byte left by 1
    reversedByte |= (byte & 1); // Set the least significant bit of the reversed byte
    byte >>= 1;                 // Shift the original byte right by 1
  }
  return reversedByte;
}

void reverseBitsInArray(unsigned char *array, int arraySize)
{
  for (int i = 0; i < arraySize; ++i)
  {
    unsigned char originalByte = pgm_read_byte(&array[i]); // Read from program memory if needed
    unsigned char reversedByte = reverseBits(originalByte);

    // // Check if PROGMEM is used
    // #ifdef PROGMEM
    //     // If PROGMEM is used, you might need a special function to write back to program memory
    //      pgm_write_byte(&array[i], reversedByte);
    // #else
    //     // If not using PROGMEM, directly modify the array
    //     array[i] = reversedByte;
    // #endif

    array[i] = reversedByte;
  }
}

void ProgressBarFPS::doProgressBarFPS(Adafruit_SSD1306 &display)
{
  // Your loop code here
  display.clearDisplay();
  int currentNumber = 0;

  if (_up)
  {
    currentNumber = (_loopCounter++ % 100) + 1;
    if (currentNumber == 100)
    {
      _loopCounter--;
      _up = !_up;
    }
  }
  else
  {
    currentNumber = (_loopCounter-- % 100) + 1;
    if (currentNumber == 1)
    {
      _loopCounter++;
      _up = !_up;
    }
  }

  drawProgressBar(display, 0, 0, currentNumber, false);

  display.setTextSize(2);
  display.setCursor(10, 10);
  display.print(currentNumber);

  display.display();
}

////////////
#define COFFEE_HEIGHT 82
#define COFFEE_WIDTH 128

// array size is 1312
unsigned char coffee[] = {
    B11111111, B11111111, B11111111, B11111111, B11111111, B11111111, B11111111, B11111111, B11111111, B11111111, B11111111, B11111111, B11111111, B11111111, B11111111, B11111111,
    B11111111, B11111111, B11111111, B11111111, B11111111, B11111111, B11111111, B11111111, B11111111, B11111111, B11111111, B11111111, B11111111, B11111111, B11111111, B11111111,
    B11111111, B11111111, B11111111, B11111111, B11111111, B11111111, B11111111, B11111111, B11111111, B11111111, B11111111, B11111111, B11111111, B11111111, B11111111, B11111111,
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    B11111111, B11111111, B11111111, B11111111, B11111111, B11111111, B11111111, B11111111, B11111111, B11111111, B11111111, B11111111, B11111111, B11111111, B11111111, B11111111};
////////////

const char *connectToWiFi(Adafruit_SSD1306 &display, int flashLight)
{

  const char *ssids[] = {
      "DarkNet",
      "DarkNet3Middle",
      "DarkNet3Top",
      "DarkNet3"};
  const char *password = "7pu77ies77";

  int numSsids = sizeof(ssids) / sizeof(ssids[0]);
  display.clearDisplay();
  display.fillScreen(SSD1306_BLACK);
  // display.setCursor(0, 0);

  // array size is 64

  // display.setRotation(90);
  display.clearDisplay();
  display.display();
  display.setTextWrap(false);

  reverseBitsInArray(coffee, 1312);
  display.drawXBitmap(0, 0, coffee, 128, 64, SSD1306_WHITE);

  display.display();
  delay(5000);

  for (;;)
  {

    for (const char *ssid : ssids)
    {

      display.clearDisplay();
      // text display tests
      display.setTextSize(1);
      display.setTextColor(SSD1306_WHITE);
      display.setCursor(0, 0);
      display.print("SSID:");
      display.println(ssid);
      display.display();

      int counter = 0;
      WiFi.begin(ssid, password);
      unsigned long startTime = millis();
      while (WiFi.status() != WL_CONNECTED)
      {
        delay(500);
        Serial.print(".");

        if ((counter++ % 2) == 0)
        {
          // Serial.println("HIGH");
          digitalWrite(flashLight, HIGH);
        }
        else
        {
          // Serial.println("LOW");
          digitalWrite(flashLight, LOW);
        }

        if (millis() - startTime > 20000)
        {
          break;
        }
      }

      if (WiFi.status() == WL_CONNECTED)
      {
        return ssid;
      }
    }

    display.clearDisplay();
    display.setTextSize(2);
    display.setTextColor(SSD1306_WHITE);
    display.setCursor(10, 0);
    display.print("WAITING...");
    display.display();

    delay(5000);
  }
}

void handleBackgroundTask(void *pvParameters)
{
  Adafruit_SSD1306 *display = static_cast<Adafruit_SSD1306 *>(pvParameters);
  // Code to run periodically in the background

  bool touched = touchRead(13) < 55;

  // Serial.print("handleBackgroundTask:");
  // Serial.println(touched);
  display->ssd1306_command(SSD1306_SETCONTRAST); // 0x81 is the command for contrast
  if (touched)
  {
    display->ssd1306_command(255);
  }
  else
  {
    display->ssd1306_command(1);
  }
}

void backgroundTask(void *pvParameters)
{

  while (true)
  {
    // Background task

    handleBackgroundTask(pvParameters);
    vTaskDelay(33 / portTICK_PERIOD_MS); // Delay for 1 second
  }
}

void showVersion(void *pvParameters)
{

  while (true)
  {
    // Background task

    Serial.println(__VERSION__);
    Serial.println(__cplusplus);

    vTaskDelay(2000 / portTICK_PERIOD_MS); // Delay for 1 second
  }
}